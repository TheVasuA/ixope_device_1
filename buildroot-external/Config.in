## buildroot-external/Config.in
```kconfig
source "$BR2_EXTERNAL_IXOPE_PATH/package/ixope-app/Config.in"
source "$BR2_EXTERNAL_IXOPE_PATH/package/aic8800-wifi/Config.in"
```

## buildroot-external/package/aic8800-wifi/Config.in
```kconfig
config BR2_PACKAGE_AIC8800_WIFI
	bool "aic8800-wifi"
	depends on BR2_LINUX_KERNEL
	help
	  AIC8800 SDIO WiFi driver for Radxa Zero 3W (and similar boards).
	  Builds the aic8800_bsp, aic8800_fdrv, and aic8800_btlpm kernel
	  modules, and installs firmware blobs.

	  https://github.com/radxa-pkg/aic8800
```

## buildroot-external/package/ixope-app/Config.in
```kconfig
config BR2_PACKAGE_IXOPE_APP
	bool "ixope-app"
	depends on BR2_PACKAGE_PYTHON3
	depends on BR2_PACKAGE_PYTHON_PILLOW
	depends on BR2_PACKAGE_OPENCV4
	help
	  IXOPE Medical Device Application - Fullscreen camera UI
	  for 480x480 round display with LED control, recording,
	  and Wi-Fi management.
```
